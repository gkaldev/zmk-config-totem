/* source key position labels */
#include "zmk-helpers/key-labels/42.h"

/* map Zen's extra keys */
#define X_LT  &kp ESC      // extra left top
#define X_LM  &kp LCTRL    // extra row, left middle
#define X_LB  &kp LSHFT    // extra row, left bottom
#define X_RT  &kp BSPC     // extra right top
#define X_RM  &kp SQT      // extra right middle
#define X_RB  &kp RSHFT    // extra right bottom

/* activate bluetooth */
#define CONFIG_WIRELESS

/* source the main keymap */
#include "base.keymap"

/* use 5-column layout for Zen */
// ZMK_APPLY_MATRIX_TRANSFORM(five_column_transform)
