/* source key position labels */
#include "zmk-helpers/key-labels/totem.h"

/* map Zen's extra keys */
#define X_LB  &kp LSHFT    // thumb row, left
#define X_RB  &kp RSHFT    // thumb row, left

/* activate bluetooth */
#define CONFIG_WIRELESS

/* source the main keymap */
#include "base.keymap"

/* use 5-column layout for Zen */
// ZMK_APPLY_MATRIX_TRANSFORM(five_column_transform)
